## app/Config.in
```kconfig
config BR2_PACKAGE_APPSENSOR
	bool "Sensor Monitoring Application"
	depends on BR2_PACKAGE_CJSON
	help
	  Ứng dụng giám sát cảm biến sử dụng 3 driver (mq2, dht11, buzzer), có watchdog và ghi log.
```

## buzzer/Config.in
```kconfig
config BR2_PACKAGE_BUZZER
    bool "buzzer driver"
    help
      Kernel module to control a buzzer on BeagleBone Black
```

## mq2/Config.in
```kconfig
config BR2_PACKAGE_MQ2SENSOR
    bool "mq2sensor driver"
    help
      Kernel module for MQ2 gas sensor using ADS1115 via I2C bit-banging
```
